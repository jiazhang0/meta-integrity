## conf/layer.conf
```bitbake
#
# Copyright (C) 2017 Wind River Systems, Inc.
#

# We have a conf and classes directory, add to BBPATH
BBPATH =. "${LAYERDIR}:"

# We have a packages directory, add to BBFILES
BBFILES += "${LAYERDIR}/recipes-*/*/*.bb \
        ${LAYERDIR}/recipes-*/*/*.bbappend"

BBFILE_COLLECTIONS += "meta-integrity"
BBFILE_PATTERN_meta-integrity = "^${LAYERDIR}/"
BBFILE_PRIORITY_meta-integrity = "7"

# This should only be incremented on significant changes that will
# cause compatibility issues with other layers
LAYERVERSION_meta-integrity = "1"

IMA_SIGNING_BLACKLIST ??= "${LAYERDIR}/files/ima_signing_blacklist"

LAYERDEPENDS_meta-integrity = "\
    core \
    meta-signing-key \
    meta-tpm2 \
    meta-tpm \
"
```
